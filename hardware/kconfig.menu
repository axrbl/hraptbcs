## hardware/kconfig.menu
```kconfig
############################################################################
mainmenu "Highly Reliable & Accurate Predicted Time-Bound Completion System"
############################################################################


rsource "soc/$(SOC)/kconfig.menu"

rsource "modules/*/kconfig.menu"
```

## software/Kconfig.menu
```kconfig
############################################################################
mainmenu "Highly Reliable & Accurate Predicted Time-Bound Completion System"
############################################################################


menu "Application / Sample / Test"
    source "$(APP)/Kconfig.*"
    menu "Build Options"
        source "scripts/build/Kconfig"
    endmenu #Build Options
endmenu #Application


menu "Hardware Board Platform"
    source "platform/board/$(BOARD)/Kconfig$(BRDVER)"
    source "platform/soc/$(soc)/Kconfig"
    menu "Architecture<$(normalize_upper,$(arch))> Processor"
        source "runtime/arch/Kconfig"
    endmenu #Architecture<???> Processor
    menu "Peripheral Devices & Drivers"
        source "runtime/device/Kconfig"
    endmenu #Peripheral Devices & Drivers
endmenu #Hardware Board Platform


menu "Software Runtime"
    source "runtime/kernel/Kconfig"
endmenu #Software Runtime


menu "SubSystem & Service"
     source "runtime/service/*/Kconfig"
    osource "service/*/Kconfig"
    osource "platform/service/*/Kconfig"
endmenu #SubSystem & Service
```

## software/kconfig.build
```kconfig
# Copyright (c) 2024 libryan@outlook.com
# SPDX-License-Identifier: Apache-2.0
#
# menuconfig @'Real Time Application Build System / Build Options'
#


choice TARGET_BUILD_MODE
    bool "Target Build Mode"
    config BUILD_FOR_ENGINEER
        bool "engineer - build for development & debugging purpose only"

    config BUILD_FOR_USER_DBG
        bool "user_debug - build for preview purpose, such as alpha|beta|rc version"

    config BUILD_FOR_USER
        bool "user - build for final user or rc version"
endchoice #TARGET_BUILD_MODE


choice #TOOLCHAIN
    bool "Toolchain"
    config TOOLCHAIN_AUTO_DETECTED
        bool "auto detect"

    config TOOLCHAIN_GCC
        bool "GNU-CC"

    config TOOLCHAIN_CLANG
        bool "LLVM-Clang"

    config TOOLCHAIN_ARMCLANG
        depends on ARCH_ARM
        bool "ARM-Clang"
endchoice #Select

config TOOLCHAIN
    default "armclang"  if TOOLCHAIN_ARMCLANG
    default "clang"     if TOOLCHAIN_CLANG
    default "gcc"      #if TOOLCHAIN_GCC
    string

config TOOLCHAIN_PREFIX
    string "Prefix for toolchain"
    default ""


menu "Compile"
    config CFLAGS
        string "Common C/C++ flags"
        default ""

    menuconfig OPTIMIZATION_BY_BUILD_MODE
    bool "Auto &| specified optimization by build mode"
    default y
    help
        Optimization flags will be used from default value or menuconfig's
        Specification if this option be selected by deault.
        Otherwise: it shuld be specified in toolchain's `C/C++ Specific`.

    if OPTIMIZATION_BY_BUILD_MODE
        config CC_OPTIMIZATION_FOR_ENGINEER
            string "Optimization for `engineer` build"
            default "-O1 -g"  if TOOLCHAIN_CLANG || TOOLCHAIN_ARMCLANG
            default "-Og -g" #if TOOLCHAIN_GCC

        config CC_OPTIMIZATION_FOR_USERDEBUG
            string "Optimization for `user_debug` build"
            default "-Os -g"

        config CC_OPTIMIZATION_FOR_USER
            string "Optimization for `user` build"
            default "-Os"

        config CC_OPTIMIZATION
            default CC_OPTIMIZATION_FOR_USER_DBG  if BUILD_FOR_USER_DBG
            default CC_OPTIMIZATION_FOR_USER      if BUILD_FOR_USER
            default CC_OPTIMIZATION_FOR_ENGINEER #if BUILD_FOR_ENGINEER
            string
    endif #OPTIMIZATION_BY_BUILD_MODE

    config CC_WARN_ALL
        bool "Enable all compile warnings"
        default n if BUILD_FOR_ENG
        default y

    config CC_WARN_AS_ERROR
        bool "Treat the warnning as an error"
        default y
endmenu #Compile


menu "Link"
    config TARGET_NAME
        string "Target program name"
        default "$(TARGET)"

    config TARGET_SUFFIX
        string "Target program suffix"
        default "elf"

    config LFLAGS
        string "Extras flag(s)"
        default ""

    config ROM_LINK
        bool "Rom link Mode"
        default n
        help
            Marks program will boot from ROM & self extracted, MUST be selected by BootROM

    config LINK_SCRIPT
        string "Link script"
        default "link.sct" if TOOLCHAIN_ARMCLANG
        default "link.ld"
        help
            The path relative to the board

    config OUT_STRIPED
        bool "Strip final target"
        default y if BUILD_FOR_USER
        default n
endmenu #Link
```

## software/runtime/service/console/kconfig.menu
```kconfig
config CONSOLE
    bool


menuconfig SERVICE_CONSOLE
    bool "Console"
    default y if CONSOLE
if SERVICE_CONSOLE



endif #SERVICE_CONSOLE
```

## software/runtime/service/diagnose/asan/kconfig.menu
```kconfig
menuconfig DIAGNOSE_ASAN
    bool "AddressSanitizer"
if DIAGNOSE_ASAN



endif #DIAGNOSE_ASAN
```

## software/runtime/service/diagnose/assert/kconfig.menu
```kconfig
menuconfig DIAGNOSE_ASSERT
    bool "Assertion"
if DIAGNOSE_ASSERT



endif #DIAGNOSE_ASSERT
```

## software/runtime/service/diagnose/kconfig.menu
```kconfig
config DIAGNOSE
    bool


menuconfig SERVICE_DIAGNOSE
    bool "Diagnose"
    default y if DIAGNOSE
if SERVICE_DIAGNOSE

rsource "*/kconfig.menu"

endif #SERVICE_DIAGNOSE
```

## software/runtime/service/diagnose/logging/kconfig.menu
```kconfig
menuconfig DIAGNOSE_LOGGING
    bool "Logging"
if DIAGNOSE_LOGGING



endif #DIAGNOSE_LOGGING
```

## software/runtime/service/diagnose/trace/kconfig.menu
```kconfig
menuconfig DIAGNOSE_TRACE
    bool "Trace"
if DIAGNOSE_TRACE



endif #DIAGNOSE_TRACE
```

## software/runtime/service/diagnose/wdt/kconfig.menu
```kconfig
menuconfig DIAGNOSE_WDT
    bool "Watchdog"
if DIAGNOSE_WDT



endif #DIAGNOSE_WDT
```

## software/runtime/service/ppcm/kconfig.menu
```kconfig
config PPM
    bool


menuconfig SERVICE_PPM
    bool "Power & Performance Management"
    default y if PPM
if SERVICE_PPM



endif #SERVICE_PM
```

## software/runtime/service/security/kconfig.menu
```kconfig
config SECURITY
    bool


menuconfig SERVICE_SECURITY
    bool "Security"
    default y if SECURITY
if SERVICE_SECURITY



endif #SERVICE_SECURITY
```

## software/runtime/service/storage/kconfig.menu
```kconfig
config STORAGE
    bool


menuconfig SERVICE_STORAGE
    bool "Storage"
    default y if STORAGE
if SERVICE_STORAGE



endif #SERVICE_STORAGE
```

## software/service/audio/kconfig.menu
```kconfig
config AUDIO
    bool


menuconfig SERVICE_AUDIO
    bool "Audio"
    default y if AUDIO
if SERVICE_AUDIO



endif #SERVICE_AUDIO
```

## software/service/camera/kconfig.menu
```kconfig
config CAMERA
    bool


menuconfig SERVICE_CAMERA
    bool "Camera"
    default y if CAMERA
if SERVICE_CAMERA



endif #SERVICE_CAMERA
```

## software/service/display/kconfig.menu
```kconfig
config DISPLAY
    bool


menuconfig SERVICE_DISPLAY
    bool "Display"
    default y if DISPLAY
if SERVICE_DISPLAY



endif #SERVICE_DISPLAY
```

## software/service/video/kconfig.menu
```kconfig
config VIDEO
    bool


menuconfig SERVICE_DISPLAY
    bool "Video"
    default y if VIDEO
if SERVICE_DISPLAY



endif #SERVICE_DISPLAY
```
